## main/Kconfig.projbuild
```kconfig
menu "nasxx-beacon"

config BEACON_WIFI_SSID
    string "Wi-Fi SSID"
    default "myssid"
    help
        Beacon 设备连接的 Wi-Fi SSID。生产环境应改为配网流程写入 NVS。

config BEACON_WIFI_PASSWORD
    string "Wi-Fi Password"
    default "mypassword"
    help
        Wi-Fi 密码。

config BEACON_DEFAULT_BROKER_HOST
    string "Default MQTT broker host (nxx-server)"
    default "nasxx.local"
    help
        未配对时使用的默认 broker 主机名。配对后会被 NVS 中的值覆盖。

config BEACON_DEFAULT_BROKER_PORT
    int "Default MQTT broker TLS port"
    default 8883

endmenu
```

## sdkconfig.defaults
```kconfig
# Partition table
CONFIG_PARTITION_TABLE_CUSTOM=y
CONFIG_PARTITION_TABLE_CUSTOM_FILENAME="partitions.csv"
CONFIG_PARTITION_TABLE_FILENAME="partitions.csv"

# Wi-Fi
CONFIG_ESP_WIFI_STA_DISCONNECT_ON_DEINIT=y
CONFIG_ESP_WIFI_STA_RECONNECT_WHEN_WIFI_LOST=y

# MQTT — tls by default; broker host/port set at runtime from NVS
CONFIG_MQTT_PROTOCOL_SSL=y

# FreeRTOS
CONFIG_FREERTOS_HZ=1000

# NVS encrypt — disable by default for dev; enable in production
CONFIG_NVS_ENCRYPTION=n

# Logging
CONFIG_LOG_DEFAULT_LEVEL_INFO=y
CONFIG_LOG_COLORS=y

# ESP32-S3 default flash size 8MB
CONFIG_ESPTOOLPY_FLASHSIZE_8MB=y
CONFIG_ESPTOOLPY_FLASHSIZE="8MB"

# PSRAM (ESP32-S3常见模组带 8MB PSRAM)
CONFIG_SPIRAM=y
CONFIG_SPIRAM_USE_MALLOC=y
```
